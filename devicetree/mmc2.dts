/dts-v1/;
/plugin/;

/ {
	compatible = "nextthing,chip", "allwinner,sun5i-r8";
	
	fragment@0 {
		target = <&mmc2_pins_a>;
		__overlay__ {
				pins = "PE4", "PE5", "PE6", "PE7", "PE8", "PE9";
		};
	};

	fragment@1 {
		target = <&mmc2>;
		__overlay__ {
			pinctrl-names = "default";
			pinctrl-0 = <&mmc2_pins_a>;
			vmmc-supply = <&reg_vcc3v3>;
			vqmmc-supply = <&reg_vcc3v3>;
			bus-width = <4>;
			broken-cd;
			status = "okay";
		};
	};
};
