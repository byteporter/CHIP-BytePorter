#include <dt-bindings/gpio/gpio.h>
#include <dt-bindings/interrupt-controller/irq.h>
#include <dt-bindings/clock/sun5i-ccu.h>
#include <dt-bindings/reset/sun5i-ccu.h>

/ {
	compatible = "nextthing,chip", "allwinner,sun5i-r8";

  fragment@0 {
    target-path = "/soc";
    __overlay__ {
      gpu: gpu@01c40000 {
        compatible = "arm,mali-400", "allwinner,sun4i-a10-mali";
			  reg = <0x1c40000 0x10000>;
        interrupts = <69 70 71 72 73>;
        interrupt-names = "IRQGP", "IRQGPMMU", "IRQPP0", "IRQPPMMU0", "IRQPMU";
        clocks = <&ccu CLK_AHB_GPU CLK_GPU>;
        clock-names = "ahb", "mod";
        resets = <&ccu RST_GPU>;
      };
    };
  };
};