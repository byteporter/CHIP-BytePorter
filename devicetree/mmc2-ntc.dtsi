/dts-v1/;
/plugin/;

#include <dt-bindings/pinctrl/sun4i-a10.h>
#include <dt-bindings/gpio/gpio.h>
#include <dt-bindings/input/input.h>
#include <dt-bindings/interrupt-controller/irq.h>

/ {
	compatible = "nextthing,chip", "allwinner,sun5i-r8";
	
	/* 	 Enable our SDIO pins		 */
	fragment@0 {
		target = <&pio>;		
		__overlay__ {

			chip_sdio_pins: mmc2@42 {
				allwinner,pins = "PE4", "PE5", "PE6", "PE7", "PE8", "PE9";
				allwinner,function = "mmc2";
				allwinner,drive = <SUN4I_PINCTRL_30_MA>;
				allwinner,pull = <SUN4I_PINCTRL_PULL_UP>;
			};
		};
	};


	/*	 Enable our SDIO device	 */
	fragment@1 {
		target = <&mmc2 >;

		__overlay__ {
			vmmc-supply = <&reg_vcc3v3>;
			vqmmc-supply = <&reg_vcc3v3>;
			// everything below this like is default, but I'll set it to be sure
			pinctrl-names = "default";
			compatible = "allwinner,sun5i-a13-mmc";
			pinctrl-0 = <&chip_sdio_pins>;

			bus-width = <4>;
      clocks = <&ahb_gates 10>,<&mmc2_clk 0>,<&mmc2_clk 1>,<&mmc2_clk 2>;
			// and go!
			status = "okay";
		};
	};
	
};