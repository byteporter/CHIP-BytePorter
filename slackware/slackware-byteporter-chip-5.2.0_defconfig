## u-boot/configs/CHIP_byteporter_defconfig
```kconfig
CONFIG_ARM=y
CONFIG_ARCH_SUNXI=y
CONFIG_SPL=y
CONFIG_MACH_SUN5I=y
CONFIG_DRAM_TIMINGS_DDR3_800E_1066G_1333J=y
CONFIG_MMC2_PINS="PE"
CONFIG_MMC_SUNXI_SLOT_EXTRA=2
CONFIG_USB0_VBUS_PIN="PB10"
CONFIG_I2C1_ENABLE=y
CONFIG_AXP_GPIO=y
CONFIG_VIDEO_COMPOSITE=y
CONFIG_VIDEO_LCD_MODE="x:480,y:272,depth:18,pclk_khz:9000,le:10,ri:5,up:3,lo:8,hs:30,vs:5,sync:3,vmode:0"
CONFIG_VIDEO_LCD_POWER="AXP0-1"
CONFIG_VIDEO_LCD_BL_EN="PD18"
CONFIG_VIDEO_LCD_BL_PWM="PB2"
CONFIG_NR_DRAM_BANKS=1
CONFIG_BOOTCOMMAND="mw.l 0x01c20890 0x44440000;mw.l 0x01c20894 0x00000044;mw.l 0x01c208a4 0x00aaaaaa;mw.l 0x01c208ac 0x00555555;mmc dev 1;run distro_bootcmd"
CONFIG_SPL_I2C_SUPPORT=y
CONFIG_CMD_DFU=y
CONFIG_CMD_USB_MASS_STORAGE=y
# CONFIG_CMD_UBI is not set
# CONFIG_SPL_DOS_PARTITION is not set
# CONFIG_SPL_EFI_PARTITION is not set
CONFIG_DEFAULT_DEVICE_TREE="sun5i-r8-chip"
# CONFIG_ENV_IS_IN_FAT is not set
CONFIG_DFU_RAM=y
CONFIG_FASTBOOT_FLASH_MMC_DEV=0
CONFIG_MMC_BROKEN_CD=y
CONFIG_NAND=y
CONFIG_SYS_NAND_BLOCK_SIZE=0x400000
CONFIG_SYS_NAND_PAGE_SIZE=0x4000
CONFIG_SYS_NAND_OOBSIZE=0x500
CONFIG_SYS_NAND_U_BOOT_OFFS_REDUND=0xc00000
CONFIG_AXP_ALDO3_VOLT=3300
CONFIG_AXP_ALDO4_VOLT=3300
CONFIG_CONS_INDEX=2
CONFIG_USB_EHCI_HCD=y
CONFIG_USB_OHCI_HCD=y
CONFIG_USB_MUSB_GADGET=y
CONFIG_SYS_USB_EVENT_POLL_VIA_INT_QUEUE=y
```
